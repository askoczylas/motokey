/ {
    chosen {
        zmk,kscan = &kscan0;
    };

    kscan0: kscan_0 {
        compatible = "zmk,kscan-gpio-direct";
        label = "KSCAN";
        input-gpios
            = <&shippin 2 (GPIO_ACTIVE_LOW | GPIO_PULL_UP)> // D0
            , <&shippin 3 (GPIO_ACTIVE_LOW | GPIO_PULL_UP)> // D1
            , <&shippin 4 (GPIO_ACTIVE_LOW | GPIO_PULL_UP)> // D2
            , <&shippin 5 (GPIO_ACTIVE_LOW | GPIO_PULL_UP)> // D3
            ;
    };
};
